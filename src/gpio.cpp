/***************************************************************************************************************************************************************************************************************************************************************************************************************************************************************************************************
 * Introduction
 **************************************************************************************************************************************************************************************************************************************************************************************************************************************************************************************************/

/**********************************************************************************************************************************************************************************************************************************************************************************************************************************************************************************************//**
 * @file      gpio.cpp
 * 
 * @version   1.0
 *
 * @date      17-10-2024
 *
 * @brief     Functions to use the GPIO in the ESP32
 *
 * @author    Fábio D. Pacheco 
 * @email     pacheco.castro.fabio@gmail.com
 * 
 * @copyright Copyright (c) [2024] [Fábio D. Pacheco]
 * 
 * @note      The I/O GPIO pads are 0-19, 21-23, 25-27, 32-39, while the output GPIOs are 0-19, 21-23, 25-27, 32-33. GPIO pads 34-39 are input-only.
 **************************************************************************************************************************************************************************************************************************************************************************************************************************************************************************************************/

/***************************************************************************************************************************************************************************************************************************************************************************************************************************************************************************************************
 * Imported libraries
 **************************************************************************************************************************************************************************************************************************************************************************************************************************************************************************************************/

#include <gpio.h>

/***************************************************************************************************************************************************************************************************************************************************************************************************************************************************************************************************
 * Global objects and variables
 **************************************************************************************************************************************************************************************************************************************************************************************************************************************************************************************************/

GPIO gpio;                                                                     ///< Object associated with GPIO

/***************************************************************************************************************************************************************************************************************************************************************************************************************************************************************************************************
 * Object primitives
 **************************************************************************************************************************************************************************************************************************************************************************************************************************************************************************************************/

/**********************************************************************************************************************************************************************************************************************************************************************************************************************************************************************************************//**
 * @brief Allocates resources associated with the GPIO object. Does not perform any hardware deconfiguration or reset.
 *
 * @param none
 *
 * @return none
 **************************************************************************************************************************************************************************************************************************************************************************************************************************************************************************************************/
GPIO::GPIO( ) : mask(0), mask1(0) { };


/**********************************************************************************************************************************************************************************************************************************************************************************************************************************************************************************************//**
 * @brief Releases any allocated resources associated with the GPIO object. Does not perform any hardware deconfiguration or reset.
 *
 * @param none
 *
 * @return none
 **************************************************************************************************************************************************************************************************************************************************************************************************************************************************************************************************/
GPIO::~GPIO( ) { };

/**********************************************************************************************************************************************************************************************************************************************************************************************************************************************************************************************//**
 * @brief Configures the mode of the specified GPIO pin as either input or output.
 * 
 * @param[in] pin The GPIO pin number to configure (0–39).
 * @param[in] state The desired mode for the pin. Options are:
 * 
 *    - `INPUT`  : Configures the pin as an input.
 * 
 *    - `OUTPUT` : Configures the pin as an output.
 * 
 * @return One of the following values:
 * 
 *   - `INPUT`   : If the pin is successfully configured as an input.
 * 
 *   - `OUTPUT`  : If the pin is successfully configured as an output.
 * 
 *   - `FAILURE` : If the specified pin number is invalid (greater than 39).
 *
 * @note  This function updates the appropriate GPIO enable register to set the pin mode.
 *
 **************************************************************************************************************************************************************************************************************************************************************************************************************************************************************************************************/
uint8_t 
GPIO::mode( uint8_t pin, uint8_t state ){
  if( 39 < pin )
    return FAILURE;

  if( INPUT == state )
    return INPUT;
  
  if( 32 > pin ){
    mask |= ( 1 << pin );
    UPDATE_REGISTER( GPIO_ENABLE_W1TS_REG, mask, |= );
  }
  else{
    mask1 |= ( 1 << (pin - 32) );   
    UPDATE_REGISTER( GPIO_ENABLE1_W1TS_REG, mask1, |= );
  }
  return OUTPUT;
}


/**********************************************************************************************************************************************************************************************************************************************************************************************************************************************************************************************//**
 * @brief Writes a specified state (HIGH, LOW, or TOGGLE) to the given GPIO pin.
 * 
 * @param[in] pin The GPIO pin number to write to (0–33).
 * @param[in] state The desired state for the pin. Options are:
 * 
 *    - `HIGH`: Sets the pin to a high logic level.
 * 
 *    - `LOW`: Sets the pin to a low logic level.
 *
 *    - `TOGGLE`: Inverts the current state of the pin.
 * 
 * @return One of the following values:
 * 
 *   - `HIGH`: If the pin is successfully set to a high state.
 * 
 *   - `LOW`: If the pin is successfully set to a low state.
 * 
 *   - `TOGGLE`: If the pin's state is successfully toggled.
 * 
 *   - `FAILURE`: If the specified pin is invalid or not configured as an output.
 *
 * @note  Validates if the pin is within range and configured as an output before performing the write operation.
 *
 **************************************************************************************************************************************************************************************************************************************************************************************************************************************************************************************************/
uint8_t 
GPIO::write( uint8_t pin, uint8_t state ){
  if( 33 < pin )
    return FAILURE;

  if( 32 > pin ){
    if( !((1 << pin) & mask) )                                                   // Check if the pin is selected as an output   
      return FAILURE;
  }
  else{ 
    if( !((1 << (pin - 32)) & mask1) )                                           // Check if the pin is selected as an output   
      return FAILURE;
  }

  switch( state ){
    default:
    case LOW:
      if( 32 > pin )
        UPDATE_REGISTER( GPIO_OUT_W1TC_REG, (1 << pin), |= );
      else
        UPDATE_REGISTER( GPIO_OUT1_W1TC_REG, (1 << (pin - 32)), |= );
      return LOW;
    
    case HIGH:
      if( 32 > pin )
        UPDATE_REGISTER( GPIO_OUT_W1TS_REG, (1 << pin), |= );
      else
        UPDATE_REGISTER( GPIO_OUT_W1TS_REG, (1 << (pin - 32)), |= );
      return HIGH;
    
    case TOGGLE:
      if( 32 > pin )
        UPDATE_REGISTER( GPIO_OUT_REG, (1 << pin), ^= );
      else
        UPDATE_REGISTER( GPIO_OUT_REG, (1 << (pin - 32)), ^= );
      return TOGGLE;
  }
  return FAILURE;
}

/**********************************************************************************************************************************************************************************************************************************************************************************************************************************************************************************************//**
 * @brief Reads the current state of the specified GPIO pin.
 * 
 * @param[in] pin The GPIO pin number to write to (0–39).

 * @return One of the following values:
 * 
 *   - `HIGH`: If the pin's state is HIGH (logic level 1).
 * 
 *   - `LOW`: If the pin's state is LOW (logic level 0).
 * 
 *   - `FAILURE`: If the specified pin is invalid or not configured as an output.
 *
 * @note  Validates if the pin is within range before performing the read operation.
 *
 **************************************************************************************************************************************************************************************************************************************************************************************************************************************************************************************************/
uint8_t
GPIO::read( uint8_t pin ){
  if( 39 < pin )
    return FAILURE;

  if( 32 > pin ){
    if( ((1 << pin) & mask) )                                                   // Check if the pin is selected as an input   
      return FAILURE;
  }
  else{ 
    if( ((1 << (pin - 32)) & mask1) )                                           // Check if the pin is selected as an input   
      return FAILURE;
  }

  if( 32 > pin )
    return ( READ_REGISTER( GPIO_IN_REG ) & (1 << pin) ) != 0;
  else
    return ( READ_REGISTER( GPIO_IN1_REG ) & (1 << (pin - 32)) ) != 0;
}

/***************************************************************************************************************************************************************************************************************************************************************************************************************************************************************************************************
 * End of file
 **************************************************************************************************************************************************************************************************************************************************************************************************************************************************************************************************/