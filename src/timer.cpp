/***************************************************************************************************************************************************************************************************************************************************************************************************************************************************************************************************
 * Introduction
 **************************************************************************************************************************************************************************************************************************************************************************************************************************************************************************************************/

/**********************************************************************************************************************************************************************************************************************************************************************************************************************************************************************************************//**
 * @file      timer.cpp
 * 
 * @version   1.0
 *
 * @date      18-10-2024
 *
 * @brief     Functions for configuring and using the TIMERs on the ESP32-WROOM-32D
 * 
 * @author    Fábio D. Pacheco, 
 * @email     pacheco.castro.fabio@gmail.com
 *
 * @copyright Copyright (c) [2024] [Fábio D. Pacheco]
 * 
 **************************************************************************************************************************************************************************************************************************************************************************************************************************************************************************************************/

/***************************************************************************************************************************************************************************************************************************************************************************************************************************************************************************************************
 * Imported libraries
 **************************************************************************************************************************************************************************************************************************************************************************************************************************************************************************************************/

#include <timer.h>

/***************************************************************************************************************************************************************************************************************************************************************************************************************************************************************************************************
 * Global objects and variables
 **************************************************************************************************************************************************************************************************************************************************************************************************************************************************************************************************/

TIMER tim0( TIMG0_0 );                                                         //!< Object associated with timer 0 from group 0 (TIMG0_0), in order to use this peripheral, initialize it by calling tim0.init( )
TIMER tim1( TIMG0_1 );                                                         //!< Object associated with timer 1 from group 0 (TIMG0_1), in order to use this peripheral, initialize it by calling tim1.init( )
TIMER tim2( TIMG1_0 );                                                         //!< Object associated with timer 0 from group 1 (TIMG1_0), in order to use this peripheral, initialize it by calling tim2.init( )
TIMER tim3( TIMG1_1 );                                                         //!< Object associated with timer 1 from group 1 (TIMG1_1), in order to use this peripheral, initialize it by calling tim3.init( )

/***************************************************************************************************************************************************************************************************************************************************************************************************************************************************************************************************
 * Object primitives
 **************************************************************************************************************************************************************************************************************************************************************************************************************************************************************************************************/

/**********************************************************************************************************************************************************************************************************************************************************************************************************************************************************************************************//**
 * @brief Allocates resources associated with the TIMER object. Does not perform any hardware deconfiguration or reset.
 *
 * @param[in] option The desired TIMER to select.
 * 
 *    - `TIMG0_0` : Timer 0 from group 0.
 * 
 *    - `TIMG0_1` : Timer 1 from group 0.
 * 
 *    - `TIMG1_0` : Timer 0 from group 1.
 *
 *    - `TIMG1_1` : Timer 1 from group 1.
 * 
 * @return none
 *
 **************************************************************************************************************************************************************************************************************************************************************************************************************************************************************************************************/
TIMER::TIMER( uint8_t option ) : flag( false ) , select( 0 ) { 
  switch( option ){
    default: break;
    case TIMG0_0: select = option; break;
    case TIMG0_1: select = option; break;
    case TIMG1_0: select = option; break;
    case TIMG1_1: select = option; break;
  }
};

/**********************************************************************************************************************************************************************************************************************************************************************************************************************************************************************************************//**
 * @brief Releases any allocated resources associated with the TIMER object. Does not perform any hardware deconfiguration or reset.
 *
 * @param none
 * 
 * @return none
 *
 **************************************************************************************************************************************************************************************************************************************************************************************************************************************************************************************************/
TIMER::~TIMER( ) { };

/**********************************************************************************************************************************************************************************************************************************************************************************************************************************************************************************************//**
 * @brief Configures and initializes the TIMER with the specified timebase and settings defined in the `cfg` structure.
 *
 * @param[in] timebase The desired timebase for the TIMER in microsseconds.
 * 
 * @return none
 *
 **************************************************************************************************************************************************************************************************************************************************************************************************************************************************************************************************/
void
TIMER::init( uint64_t timebase ){
  base = timebase;
  uint64_t ticks = 1; 

  // General Configuration (Prescalar, interruptions, ...)
  UPDATE_REGISTER( TIMG_TCONFIG_REG(select), ( cfg.TIMG_T_INCREASE      << 30 ), = );
  UPDATE_REGISTER( TIMG_TCONFIG_REG(select), ( cfg.TIMG_T_AUTORELOAD    << 29 ), |= );
  UPDATE_REGISTER( TIMG_TCONFIG_REG(select), ( cfg.TIMG_T_DIVIDER       << 13 ), |= );
  UPDATE_REGISTER( TIMG_TCONFIG_REG(select), ( cfg.TIMG_T_EDGE_INT_EN   << 12 ), |= );
  UPDATE_REGISTER( TIMG_TCONFIG_REG(select), ( cfg.TIMG_T_LEVEL_INT_EN  << 11 ), |= );
  UPDATE_REGISTER( TIMG_TCONFIG_REG(select), ( cfg.TIMG_T_ALARM_EN      << 10 ), |= );

  // WatchDog Configuration
  UPDATE_REGISTER( TIMG_WDTCONFIG_REG(select), ( cfg.TIMG_T_WDT_EN               << 31 ), = );  
  UPDATE_REGISTER( TIMG_WDTCONFIG_REG(select), ( cfg.TIMG_T_WDT_STG0             << 29 ), |= );  
  UPDATE_REGISTER( TIMG_WDTCONFIG_REG(select), ( cfg.TIMG_T_WDT_STG1             << 27 ), |= );  
  UPDATE_REGISTER( TIMG_WDTCONFIG_REG(select), ( cfg.TIMG_T_WDT_STG2             << 25 ), |= );  
  UPDATE_REGISTER( TIMG_WDTCONFIG_REG(select), ( cfg.TIMG_T_WDT_STG3             << 23 ), |= );  
  UPDATE_REGISTER( TIMG_WDTCONFIG_REG(select), ( cfg.TIMG_T_WDT_EDGE_INT_EN      << 22 ), |= );  
  UPDATE_REGISTER( TIMG_WDTCONFIG_REG(select), ( cfg.TIMG_T_WDT_LEVEL_INT_EN     << 21 ), |= );  
  UPDATE_REGISTER( TIMG_WDTCONFIG_REG(select), ( cfg.TIMG_T_WDT_CPU_RESET_LENGTH << 18 ), |= );  
  UPDATE_REGISTER( TIMG_WDTCONFIG_REG(select), ( cfg.TIMG_T_WDT_SYS_RESET_LENGTH << 15 ), |= );  
  UPDATE_REGISTER( TIMG_WDTCONFIG_REG(select), ( cfg.TIMG_T_WDT_FLASHBOOT_MOD_EN << 14 ), |= );  

  // Set the timebase, a bitwise operation is done isolate only 32 bits from the 64 bits word
  ticks = TIMG_TICKS( timebase, cfg.TIMG_T_DIVIDER );
  UPDATE_REGISTER( TIMG_TALARMLO_REG(select), (ticks >> 00) & 0xFFFFFFFF, =);
  UPDATE_REGISTER( TIMG_TALARMHI_REG(select), (ticks >> 32) & 0xFFFFFFFF, =);
  
  // Reset the counter
  CLEAR_REGISTER( TIMG_TUPDATE_REG( select ) );  

  // Turn on the device
  enable( HIGH );
}

/**********************************************************************************************************************************************************************************************************************************************************************************************************************************************************************************************//**
 * @brief Enables or disables the timer based on the specified state.
 *
 * @param[in] state Specifies the desired timer state.
 *
 *    - `HIGH` : to enable the timer.
 * 
 *    - `LOW` : to disable the timer.
 * 
 * @return none
 * 
 * @note Updates the `on` member variable to reflect the current state of the timer.
 *
 **************************************************************************************************************************************************************************************************************************************************************************************************************************************************************************************************/
void
TIMER::enable( uint8_t state ){  
  if( HIGH == state ){
    if( !(READ_REGISTER( TIMG_TCONFIG_REG(select) ) & ( HIGH << 31 )) )
      UPDATE_REGISTER( TIMG_TCONFIG_REG(select), ( HIGH << 31 ), |= );       
    on = HIGH;
  } 
  else{
    if( (READ_REGISTER( TIMG_TCONFIG_REG(select) ) & ( HIGH << 31 )) >> 31 )
      UPDATE_REGISTER( TIMG_TCONFIG_REG(select), ~( HIGH << 31 ), &= );       
    on = LOW;
  }
}

/**********************************************************************************************************************************************************************************************************************************************************************************************************************************************************************************************//**
 * @brief Blocks the procedure of the code for the time specified.
 *
 * @param[in] time The desired delay time in microsseconds.
 * 
 * @return none
 *
 * @note
 *
 *   - If the time desired is smaller then the timebase, the delay will take the time of the timebase.
 *
 *   - If the peripheral it's disable, the function will return immediately
 *
 *   - If the TIMG_T_ALARM_EN is 0, the function will return immediately
 * 
 **************************************************************************************************************************************************************************************************************************************************************************************************************************************************************************************************/
void
TIMER::delay( uint64_t time ){
  if( !on )
    return;

  uint64_t counter = 1;
  if( time > base )                                                                                // Check if it's necessary to apply a counter
    counter = time / base;

  for( uint64_t i = 0 ; i < counter ; ++i ){
    while( ((1 << 10) & READ_REGISTER( TIMG_TCONFIG_REG(select) )) );
    UPDATE_REGISTER( TIMG_TCONFIG_REG(select), ( cfg.TIMG_T_ALARM_EN << 10 ), |= );
  }
}

/**********************************************************************************************************************************************************************************************************************************************************************************************************************************************************************************************//**
 * @brief Checks whether the timer alarm has been triggered, indicating that the timebase has elapsed. If the alarm is triggered, the function rearms the timer by updating the relevant register.
 *
 * @param none
 * 
 * @return
 * 
 *   - `1`: If the timer alarm was triggered (time elapsed).
 * 
 *   - `0`: If the timer alarm was not triggered (time not elapsed).
 *
 **************************************************************************************************************************************************************************************************************************************************************************************************************************************************************************************************/
uint8_t 
TIMER::check( ){
  if( 0 == ((1 << 10) & READ_REGISTER( TIMG_TCONFIG_REG(select) )) ){
    UPDATE_REGISTER( TIMG_TCONFIG_REG(select), ( cfg.TIMG_T_ALARM_EN << 10 ), |= );
    return 1;
  }
  return 0;
}

/**********************************************************************************************************************************************************************************************************************************************************************************************************************************************************************************************//**
 * @brief Waits for 100 us and then decrements the `counter`. Counter must be configured before using this function, it's necessary to reset by hand. (Example: tim0.counter = 100)
 *
 * @param[in] timer  The timer that will be counting the time, this timer needs to be initialized, and depending on the value when initialized, the delay might vary. Refer to TIMER documentation for more information.
 * 
 * @return
 * 
 *   - `1`: If the counter is greater than 0.
 * 
 *   - `0`: If the counter is equal to 0.
 *
 **************************************************************************************************************************************************************************************************************************************************************************************************************************************************************************************************/
uint8_t 
infiniteLoopBreaker( TIMER &timer ){
  if( !timer.counter )
    return 0;

  timer.counter--;
  timer.delay( 1e2 );
  return 1;
}

/***************************************************************************************************************************************************************************************************************************************************************************************************************************************************************************************************
 * End of file
 **************************************************************************************************************************************************************************************************************************************************************************************************************************************************************************************************/